## config/boards/shields/roost/Kconfig.shield
```kconfig
# Copyright (c) 2021 The ZMK Contributors
# SPDX-License-Identifier: MIT

config SHIELD_ROOST_LEFT
	def_bool $(shields_list_contains,roost_left)

config SHIELD_ROOST_RIGHT
	def_bool $(shields_list_contains,roost_right)
```

## config/boards/shields/roostv2/Kconfig.defconfig
```kconfig
# Copyright (c) 2021 The ZMK Contributors
# SPDX-License-Identifier: MIT

if SHIELD_ROOST_LEFT

config ZMK_KEYBOARD_NAME
	default "Roostv2"

config ZMK_SPLIT_BLE_ROLE_CENTRAL
	default y

endif

if SHIELD_ROOST_LEFT || SHIELD_ROOST_RIGHT

config ZMK_SPLIT
	default y

endif
```
